## conf/layer.conf
```bitbake
# We have a conf and classes directory, add to BBPATH
BBPATH .= ":${LAYERDIR}"

# We have recipes-* directories, add to BBFILES
BBFILES += "${LAYERDIR}/recipes-*/*/*.bb \
            ${LAYERDIR}/recipes-*/*/*.bbappend"

BBFILE_COLLECTIONS += "rdk-wan"
BBFILE_PATTERN_rdk-wan = "^${LAYERDIR}/"
BBFILE_PRIORITY_rdk-wan = "6"

LAYERDEPENDS_rdk-wan = "core"
LAYERSERIES_COMPAT_rdk-wan = "zeus dunfell kirkstone scarthgap"
```
